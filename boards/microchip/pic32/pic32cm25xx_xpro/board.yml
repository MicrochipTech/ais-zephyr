## boards/microchip/pic32/pic32cm25xx_xpro/board.yml
```yaml
board:
  name: pic32cm25xx_xpro
  vendor: microchip
  socs:
    - name: pic32cm2564
```

## boards/microchip/pic32/pic32cm25xx_xpro/pic32cm25xx_xpro_defconfig
```kconfig
# Copyright (c) 2025 Microchip Technology Inc.
# SPDX-License-Identifier: Apache-2.0

CONFIG_BUILD_OUTPUT_HEX=y

CONFIG_ARM_MPU=y
CONFIG_HW_STACK_PROTECTION=y

CONFIG_CONSOLE=y
CONFIG_SERIAL=y
CONFIG_UART_CONSOLE=y
CONFIG_UART_INTERRUPT_DRIVEN=y

#CONFIG_TICKLESS_KERNEL=n
#CONFIG_MAIN_STACK_SIZE=2048
#CONFIG_STACK_CANARIES=y
```

## drivers/clock_control/Kconfig.pic32
```kconfig
# Copyright (c) 2025 Microchip Technology Inc.
# SPDX-License-Identifier: Apache-2.0

config CLOCK_CONTROL_PIC32
	bool "Microchip PIC32 clock control"
	default y
	depends on DT_HAS_MICROCHIP_PIC32_CLKRSTGEN_ENABLED
	help
	  Enable driver for Microchip PIC32 Clock Control.
```

## drivers/flash/Kconfig.pic32
```kconfig
# Microchip PIC32 flash driver config

# Copyright (c) 2025 Microchip Technology Inc.
# SPDX-License-Identifier: Apache-2.0

menuconfig SOC_FLASH_PIC32
	bool "Microchip PIC32 flash driver"
	default y
	depends on DT_HAS_MICROCHIP_PIC32_NVMCTRL_ENABLED
	select FLASH_HAS_PAGE_LAYOUT
	select FLASH_HAS_DRIVER_ENABLED
	select FLASH_HAS_EXPLICIT_ERASE
	select MPU_ALLOW_FLASH_WRITE if ARM_MPU
	help
	  Enable the Microchip PIC32 series internal flash driver.
```

## drivers/gpio/Kconfig.pic32
```kconfig
# Microchip PIC32 GPIO configuration options

# Copyright (c) 2025, Microchip Technology Inc.
# SPDX-License-Identifier: Apache-2.0

config GPIO_PIC32
	bool "Microchip PIC32 GPIO driver"
	default y
	depends on DT_HAS_MICROCHIP_PIC32_GPIO_ENABLED
	help
	  Enable support for the Microchip PIC32 GPIO controller.
```

## drivers/pinctrl/Kconfig.pic32
```kconfig
# Copyright (c) 2025, Microchip Technology Inc.
# SPDX-License-Identifier: Apache-2.0

config PINCTRL_PIC32
	bool "Microchip PIC32 pin controller driver"
	default y
	depends on DT_HAS_MICROCHIP_PIC32_PINCTRL_ENABLED
	help
	  Microchip pin controller driver is used on PIC32 SoC series
```

## drivers/serial/Kconfig.pic32
```kconfig
# Microchip PIC32 SERCOM configuration options

# Copyright (c) 2025 Microchip Technology Inc.
# SPDX-License-Identifier: Apache-2.0

config UART_PIC32
	bool "Microchip PIC32 series SERCOM UART driver"
	default y
	depends on DT_HAS_MICROCHIP_PIC32_UART_ENABLED
	select SERIAL_HAS_DRIVER
	select SERIAL_SUPPORT_INTERRUPT
	select SERIAL_SUPPORT_ASYNC if DT_HAS_MICROCHIP_PIC32_DMAC_ENABLED
	help
	  This option enables the SERCOMx USART driver for Microchip PIC32 MCUs.

config UART_PIC32_ASYNC
	bool "Async UART support for Microchip PIC32 series."
	depends on DMA_PIC32
	depends on UART_PIC32
	depends on UART_ASYNC_API
```

## drivers/watchdog/Kconfig.pic32
```kconfig
# Microchip PIC32 WDT configuration

# Copyright (c) 2025 Microchip Technology Inc.
# SPDX-License-Identifier: Apache-2.0

config WDT_PIC32
	bool "Microchip PIC32 series Watchdog (WDT) Driver"
	default y
	depends on DT_HAS_MICROCHIP_PIC32_WATCHDOG_ENABLED
	select HAS_WDT_DISABLE_AT_BOOT
	help
	  Enable WDT driver for Microchip PIC32 MCUs.
```

## dts/bindings/clock/microchip,pic32-apll-clock.yaml
```yaml
# Copyright (c) 2025, Microchip Technology Inc
# SPDX-License-Identifier: Apache-2.0

description: Microchip PIC32 APLL Clock

compatible: "microchip,pic32-apll"

include: [fixed-clock.yaml]

properties:
  clock-frequency:
    type: int
    required: true
    description: |
      clock frequency in Hz.
```

## dts/bindings/clock/microchip,pic32-clkrstgen.yaml
```yaml
# Copyright (c) 2025, Microchip Technology Inc.
# SPDX-License-Identifier: Apache-2.0

description: Microchip PIC32 Clock Reset Generator (CLKRSTGEN)

compatible: "microchip,pic32-clkrstgen"

include: [clock-controller.yaml, base.yaml]

properties:
  reg:
    required: true

  "#clock-cells":
    const: 1

clock-cells:
  - id
```

## dts/bindings/clock/microchip,pic32-fpll-clock.yaml
```yaml
# Copyright (c) 2025, Microchip Technology Inc
# SPDX-License-Identifier: Apache-2.0

description: Microchip PIC32 FPLL Clock

compatible: "microchip,pic32-fpll"

include: [fixed-clock.yaml]

properties:
  clock-frequency:
    type: int
    required: true
    description: |
      clock frequency in Hz.
```

## dts/bindings/ethernet/microchip,pic32-gmac.yaml
```yaml
# Copyright (c) 2025 Microchip Technology Inc.
# SPDX-License-Identifier: Apache-2.0

description: Microchip PIC32-family GMAC Ethernet

compatible: "microchip,pic32-gmac"

include: atmel,gmac-common.yaml
```

## dts/bindings/flash_controller/microchip,pic32-nvmctrl.yaml
```yaml
description: Microchip PIC32 NVMC (Non-Volatile Memory Controller)

compatible: "microchip,pic32-nvmctrl"

include: flash-controller.yaml

properties:
  reg:
    required: true
#properties:
#  lock-regions:
#   type: int
#    required: true
#    description: Number of lock regions
```

## dts/bindings/gpio/microchip,pic32-gpio.yaml
```yaml
description: PIC32 GPIO node

compatible: "microchip,pic32-gpio"

include: [gpio-controller.yaml, base.yaml]

properties:
  reg:
    required: true

  "#gpio-cells":
    const: 2

  ngpios:
    type: int
    required: true
    const: 16
    description: Number of gpio pins

gpio-cells:
  - pin
  - flags
```

## dts/bindings/watchdog/microchip,pic32-watchdog.yaml
```yaml
description: Microchip PIC32 watchdog

compatible: "microchip,pic32-watchdog"

include: base.yaml

properties:
  reg:
    required: true

  interrupts:
    required: true
```

## soc/microchip/pic32/Kconfig
```kconfig
# Microchip PIC32 MCU family configuration options

# Copyright (c) 2025 Microchip Technology Inc.
# SPDX-License-Identifier: Apache-2.0

config SOC_FAMILY_MICROCHIP_PIC32
	select HAS_PIC32_HAL
	select HAS_SEGGER_RTT if ZEPHYR_SEGGER_MODULE

if SOC_FAMILY_MICROCHIP_PIC32

rsource "*/Kconfig"

endif # SOC_FAMILY_MICROCHIP_PIC32
```

## soc/microchip/pic32/Kconfig.defconfig
```kconfig
# Microchip PIC32 MCU family default configuration options

# Copyright (c) 2025 Microchip Technology Inc.
# SPDX-License-Identifier: Apache-2.0

if SOC_FAMILY_MICROCHIP_PIC32

rsource "*/Kconfig.defconfig"

config GPIO
	default y

config PINCTRL
	default y

config CLOCK_CONTROL
	default y

config SYS_CLOCK_HW_CYCLES_PER_SEC
	default $(dt_node_int_prop_int,/cpus/cpu@0,clock-frequency)

endif # SOC_FAMILY_MICROCHIP_PIC32
```

## soc/microchip/pic32/pic32cm25xx/Kconfig
```kconfig
# Microchip PIC32 MCU series

# Copyright (c) 2025 Microchip Technology Inc.
# SPDX-License-Identifier: Apache-2.0

config SOC_SERIES_PIC32CM25XX
	select ARM
	select CPU_HAS_ARM_MPU
	select CPU_CORTEX_M0PLUS
	select CPU_CORTEX_M_HAS_SYSTICK
	select CPU_CORTEX_M_HAS_VTOR
	select SOC_RESET_HOOK
```

## soc/microchip/pic32/pic32cm25xx/Kconfig.defconfig
```kconfig
# Microchip PIC32 MCU series configuration options

# Copyright (c) 2025 Microchip Technology Inc.
# SPDX-License-Identifier: Apache-2.0

if SOC_SERIES_PIC32CM25XX

config NUM_IRQS
	default 32

endif # SOC_SERIES_PIC32CM25XX
```

## soc/microchip/pic32/pic32cm25xx/Kconfig.soc
```kconfig
# Copyright (c) 2025 Microchip Technology Inc.
# SPDX-License-Identifier: Apache-2.0

config SOC_SERIES_PIC32CM25XX
	bool
	select SOC_FAMILY_MICROCHIP_PIC32
	help
	  Enable support for Microchip PIC32 Cortex-M0+ microcontrollers.

config SOC_SERIES
	default "pic32cm25xx" if SOC_SERIES_PIC32CM25XX

config SOC_PIC32CM2564
	bool
	select SOC_SERIES_PIC32CM25XX

config SOC
	default "pic32cm2564" if SOC_PIC32CM2564
```
